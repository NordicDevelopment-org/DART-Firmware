// GENERATED by ndi_1w/pin_table/gen_variant.py from pin_table.csv. DO NOT EDIT BY HAND.
// One row per GPIO whose boot state initVariant() applies: (arduino pin, mode, port pin, net).
// PERIPHERAL, ANALOG, RESERVED and NC pins are left alone (stock drivers or the reset state own them).
NDI_PIN_INIT_ROW(3, NDI_INIT_INPUT, "P0.03", "QW_FLT")
NDI_PIN_INIT_ROW(6, NDI_INIT_OUTPUT_HIGH, "P0.06", "HB_LED")
NDI_PIN_INIT_ROW(7, NDI_INIT_OUTPUT_LOW, "P0.07", "HEAT_INH")
NDI_PIN_INIT_ROW(8, NDI_INIT_OUTPUT_HIGH, "P0.08", "LED_B")
NDI_PIN_INIT_ROW(9, NDI_INIT_INPUT, "P0.09", "BTN1_M")
NDI_PIN_INIT_ROW(10, NDI_INIT_INPUT, "P0.10", "FEM_FPWM")
NDI_PIN_INIT_ROW(11, NDI_INIT_INPUT, "P0.11", "PD_STAT")
NDI_PIN_INIT_ROW(12, NDI_INIT_INPUT, "P0.12", "BTN2")
NDI_PIN_INIT_ROW(17, NDI_INIT_INPUT, "P0.17", "GNSS_PPS")
NDI_PIN_INIT_ROW(19, NDI_INIT_OUTPUT_LOW, "P0.19", "RING_2_A")
NDI_PIN_INIT_ROW(20, NDI_INIT_OUTPUT_LOW, "P0.20", "RING_2_B")
NDI_PIN_INIT_ROW(21, NDI_INIT_INPUT_PULLUP, "P0.21", "COLD_STAT")
NDI_PIN_INIT_ROW(22, NDI_INIT_INPUT, "P0.22", "SOS_OUT")
NDI_PIN_INIT_ROW(23, NDI_INIT_INPUT, "P0.23", "SOS_CLR")
NDI_PIN_INIT_ROW(24, NDI_INIT_INPUT, "P0.24", "CHG_INT")
NDI_PIN_INIT_ROW(25, NDI_INIT_OUTPUT_LOW, "P0.25", "ID_EN")
NDI_PIN_INIT_ROW(26, NDI_INIT_INPUT, "P0.26", "FG_ALRT")
NDI_PIN_INIT_ROW(27, NDI_INIT_INPUT, "P0.27", "QW_EN_M")
NDI_PIN_INIT_ROW(29, NDI_INIT_INPUT, "P0.29", "ANT_FLT_M")
NDI_PIN_INIT_ROW(34, NDI_INIT_OUTPUT_LOW, "P1.02", "GNSS_EN_M")
NDI_PIN_INIT_ROW(35, NDI_INIT_OUTPUT_HIGH, "P1.03", "LED_G")
NDI_PIN_INIT_ROW(36, NDI_INIT_OUTPUT_HIGH, "P1.04", "LED_R")
NDI_PIN_INIT_ROW(37, NDI_INIT_OUTPUT_LOW, "P1.05", "FEM_EN")
NDI_PIN_INIT_ROW(38, NDI_INIT_OUTPUT_HIGH, "P1.06", "LORA_NRST")
NDI_PIN_INIT_ROW(40, NDI_INIT_OUTPUT_LOW, "P1.08", "RING_U_A")
NDI_PIN_INIT_ROW(41, NDI_INIT_OUTPUT_LOW, "P1.09", "RING_U_B")
NDI_PIN_INIT_ROW(42, NDI_INIT_OUTPUT_HIGH, "P1.10", "LORA_NSS_M")
NDI_PIN_INIT_ROW(46, NDI_INIT_INPUT, "P1.14", "LORA_BUSY")
NDI_PIN_INIT_ROW(47, NDI_INIT_INPUT, "P1.15", "LORA_DIO1")
